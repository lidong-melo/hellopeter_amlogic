## Config.in
```kconfig
config BR2_PACKAGE_HELLOPETER
    bool "hellopeter"
    help
      Peter said: AAAAAA
      see http://somewhere.com for more on this software
```

## hellopeter_test/a113/hellopeter_test/Config.in
```kconfig
config BR2_PACKAGE_HELLOPETER_TEST
    bool "hellopeter_test"
    help
      Peter said: AAAAAA
      see http://somewhere.com for more on this software
```
